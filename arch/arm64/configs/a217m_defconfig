## arch/arm64/configs/gsi_defconfig
```kconfig
# CONFIG_PSI is not set

# CONFIG_MEMCG is not set

CONFIG_ANDROID_SIMPLE_LMK=y
CONFIG_ANDROID_SIMPLE_LMK_MINFREE=128
CONFIG_ANDROID_SIMPLE_LMK_TIMEOUT_MSEC=200
```

## arch/arm64/configs/oneui_defconfig
```kconfig
CONFIG_PSI=y
# CONFIG_PSI_DEFAULT_DISABLED is not set

CONFIG_PAGE_COUNTER=y
CONFIG_MEMCG=y
CONFIG_MEMCG_SWAP=y
CONFIG_MEMCG_SWAP_ENABLED=y
CONFIG_MEMCG_FORCE_USE_VM_SWAPPINESS=y
CONFIG_MEMCG_KMEM=y
# CONFIG_SLUB_MEMCG_SYSFS_ON is not set
```
